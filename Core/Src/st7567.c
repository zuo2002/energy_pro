
#include "st7567.h"
#include "main.h"
#include <stdint.h>
#include <stdbool.h>
const unsigned char ASC8[]={


0x02,0x0C,0x10,0x20,/*"V",0*/

0x02,0x1C,0x20,0x1C,/*"W",1*/
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0x00,0x64,0x74,0x5C,/*"Z",25*/



};
 
const unsigned char ASC16[]={

0x00,0xE0,0x10,0x08,0x08,0x10,0xE0,0x00,0x00,0x0F,0x10,0x20,0x20,0x10,0x0F,0x00,/*"0",0*/

0x00,0x00,0x10,0x10,0xF8,0x00,0x00,0x00,0x00,0x00,0x20,0x20,0x3F,0x20,0x20,0x00,/*"1",1*/
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0x00,0x00,0x00,0x00,0x00,0x00,0x00,0x00,0x00,0x00,0x00,0x00,0x00,0x00,0x00,0x00,/*     */
 
};
const unsigned char ENG16[]={
0x00,0x00,0xC0,0x38,0xE0,0x00,0x00,0x00,0x20,0x3C,0x23,0x02,0x02,0x27,0x38,0x20,/*"A",0*/

0x08,0xF8,0x88,0x88,0x88,0x70,0x00,0x00,0x20,0x3F,0x20,0x20,0x20,0x11,0x0E,0x00,/*"B",1*/
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0x10,0x08,0x08,0x08,0xC8,0x38,0x08,0x00,0x20,0x38,0x26,0x21,0x20,0x20,0x18,0x00,/*"Z",25*/
};
 
const unsigned char CHN16[]={
0x00,0x00,0x00,0xF1,0x12,0x14,0x10,0x10,0x10,0x14,0x12,0xF1,0x00,0x00,0x00,0x00,
0x40,0x30,0x00,0x03,0x39,0x41,0x41,0x45,0x59,0x41,0x41,0x73,0x00,0x08,0x30,0x00,/*"总",0*/

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0x00,0x00,0x36,0x36,0x00,0x00,0x00,0x00,0x00,0x00,0x00,0x00,0x00,0x00,0x00,0x00,/*"：",72*/





 
};
 
const unsigned char ASC32[]={
0x00,0x00,0x00,0x00,0x80,0x80,0xC0,0xC0,0xC0,0xC0,0xC0,0xC0,0xC0,0x80,0x80,0x00,
0x00,0xF0,0xFE,0xFF,0x07,0x01,0x01,0x00,0x00,0x00,0x00,0x00,0x01,0x03,0x07,0xFF,
0x00,0x0F,0x7F,0xFF,0xE0,0x80,0x80,0x00,0x00,0x00,0x00,0x00,0x80,0x80,0xE0,0xFF,
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0x00,0x00,0x00,0x01,0x01,0x03,0x03,0x03,0x03,0x03,0x03,0x03,0x01,0x01,0x00,0x00,/*"9",9*/
};
 
const unsigned char CHN32[]={
0x00,0x00,0x00,0xC0,0xC0,0xC0,0xC0,0xC0,0xC0,0xC0,0xC0,0xC0,0xC0,0xC0,0xDC,0xF8,
0xE0,0xC0,0xC0,0xC0,0xC0,0xC0,0xC0,0xC0,0xC0,0xC0,0xC0,0xC0,0x80,0x00,0x00,0x00,
0x00,0x00,0x3F,0x3F,0x00,0x00,0x00,0x00,0x00,0x00,0x00,0x80,0xE0,0x70,0x1C,0x06,
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0x00,0x00,0x00,0x00,0x03,0x07,0x0E,0x18,0x00,0x07,0x3F,0x70,0xC0,0xE0,0x3F,0x00,/*"风",3*/

};

const unsigned char BMP[]={


0x00,0x00,0x00,0x00,0x00,0x00,0x00,0x00,0x00,0x00,0x00,0x00,0x00,0x00,0x00,0x00,
0x00,0x00,0x00,0x00,0x00,0x00,0x80,0x80,0x80,0x00,0x00,0x00,0x00,0xF8,0x00,0x00,
0x00,0x00,0x00,0x00,0x00,0x00,0x00,0x00,0x00,0x00,0x00,0x00,0x00,0x00,0x00,0x00,
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0x00,0x00,0x80,0xC0,0x60,0x30,0x1C,0x06,0x03,0x01,0x00,0x00,0x00,0x00,0x00,0x00,/*"未命名文件",0*/
};/*"C:\Users\28266\Desktop\页面 1.bmp",0*/





void LDZ_SendBit(u8 bit)
{	
	u8 i;
	for(i = 0;i < 8;i ++)
	{
		LDZ_SCK_L();
		if(bit & 0x80)
		   LDZ_SDA_H();
		else
		   LDZ_SDA_L();
		LDZ_SCK_H();
		bit <<= 1;
	}
} 
 
/**************************************************************************
* 函数名称： LDZ_WriteCMD/LDZ_WriteDAT
* 功能描述： 写命令/写数据
**************************************************************************/
void LDZ_WriteCMD(u8 cmd)
{
    LDZ_CS_L();
    LDZ_DC_L();
    LDZ_SendBit(cmd);
    LDZ_CS_H();
}
    
void LDZ_WriteDAT(u8 dat)
{
    LDZ_CS_L();
    LDZ_DC_H();
    LDZ_SendBit(dat);
    LDZ_CS_H();
}

/**************************************************************************
* 函数名称： LDZ_Cfg
* 功能描述： 配置屏幕
**************************************************************************/
void LDZ_Cfg(void)
{
    LDZ_WriteCMD(0xE2); //reset
    Ddl_Delay1ms(10);
    LDZ_WriteCMD(0xA2); //设置偏压比为1/9
    LDZ_WriteCMD(0xA0); //设置seg扫描正向seg0~seg131
    LDZ_WriteCMD(0xC8); //设置com扫描反向com63~com0
    LDZ_WriteCMD(0x24); //对比度粗调
    LDZ_WriteCMD(0x81); //对比度双指令
    LDZ_WriteCMD(0x2B); //对比度微调
    LDZ_WriteCMD(0x2F); //电源控制
    LDZ_WriteCMD(0xB0); //设置页地址
    LDZ_WriteCMD(0xAF); //显示打开
    LDZ_WriteCMD(0xA6); //正常显示不反转
}

/**************************************************************************
* 函数名称： LDZ_SetAddr/LDZ_ClearPage/LDZ_Clear
* 功能描述： 设置地址/清整页/清全屏
**************************************************************************/
void LDZ_SetAddr(u8 page, u8 col)
{
    LDZ_WriteCMD(0xB0|page);
    LDZ_WriteCMD((col >> 4)| 0x10);
    LDZ_WriteCMD(col & 0x0F);
}
 
void LDZ_ClearPage(u8 page)
{
    u8 i;
    LDZ_SetAddr(page, 0);
    for(i = 0;i < 128;i ++)
        LDZ_WriteDAT(0x00);
}
 
void LDZ_Clear(void)
{
    u8 i;
    for(i = 0;i < 8;i ++)
        LDZ_ClearPage(i);
}

/**************************************************************************
* 函数名称： LDZ_ShowASC16/LDZ_ShowASC32/LDZ_ShowCHN16/LDZ_ShowCHN32
* 功能描述： 显示字符
* 参数说明： [1]页地址 / [2]列地址 / [3]字符位于对应数组中的序号
**************************************************************************/
void LDZ_ShowASC8(u8 page, u8 col, u8 id)
{
    u8 i,j;
    for(i = 0;i < 2;i ++)//一共2行
	{
        LDZ_SetAddr(page++, col);
		for(j = 0;j < 4;j ++)  //一行4字节
			LDZ_WriteDAT(ASC8[j + i*4 + id*8]);
	}
}

void LDZ_ShowENG16(u8 page, u8 col, u8 id)
{
    u8 i,j;
    for(i = 0;i < 2;i ++)//一共2行
	{
        LDZ_SetAddr(page++, col);
		for(j = 0;j < 8;j ++)  //一行4字节
			LDZ_WriteDAT(ENG16[j + i*8 + id*16]);
	}
}

void LDZ_ShowASC16(u8 page, u8 col, u8 id)
{
    u8 i,j;
    for(i = 0;i < 2;i ++)//一共2行
	{
        LDZ_SetAddr(page++, col);
		for(j = 0;j < 8;j ++)  //一行8字节
			LDZ_WriteDAT(ASC16[j + i*8 + id*16]);
	}
}
 
void LDZ_ShowCHN16(u8 page, u8 col, u8 id)
{
    u8 i,j;
    for(i = 0;i < 2;i ++)   //一共2行
	{
        LDZ_SetAddr(page++, col);
		for(j = 0;j < 16;j ++)  //一行16字节
			LDZ_WriteDAT(CHN16[j + i*16 + id*32]);
	}
}
 
void LDZ_ShowASC32(u8 page, u8 col, u8 id)
{
    u8 i,j;
    for(i = 0;i < 4;i ++)   //一共4行
	{
        LDZ_SetAddr(page++, col);
		for(j = 0;j < 16;j ++)  //一行16字节
			LDZ_WriteDAT(ASC32[j+ i*16 + id*64]);
	}
}
 
void LDZ_ShowCHN32(u8 page, u8 col, u8 id)
{
    u8 i,j;
    for(i = 0;i < 4;i ++)   //一共4行
	{
        LDZ_SetAddr(page++, col);
		for(j = 0;j < 32;j ++)  //一行32字节
			LDZ_WriteDAT(CHN32[j + i*32 + id*128]);
	}
}

void LDZ_ShowBMP(u8 page, u8 col, u8 id)
{
    u8 i,j;
    for(i = 0;i < 10;i ++)   //一共8行
	{
        LDZ_SetAddr(page++, col);
		for(j = 0;j < 128;j ++)  //一行32字节
			LDZ_WriteDAT(BMP[j + i*64 + id*128]);
	}
}

// 函数功能：在特定设备上显示图片
void LDZ_ShowPicture(u8 page_start, u8 page_end, u8 col_start, u8 col_end, const uint8_t *picture_data)
{
    // 定义用于循环的页和列变量
    u8 page, col;
    // 遍历从起始页到结束页
    for (page = page_start; page <= page_end; page++)
    {
        // 设置当前页和起始列的地址
        LDZ_SetAddr(page, col_start);
        // 遍历从起始列到结束列
        for (col = col_start; col <= col_end; col++)
        {
            // 将图片数据写入当前位置，并将指针后移一位
            LDZ_WriteDAT(*picture_data++);
        }
    }
}

//void LDZ_Clean(u8 page, u8 col, u8 id)
//{
//    u8 i,j;
//    for(i = 0;i < 8;i ++)   //一共4行
//	{
//        LDZ_SetAddr(page++, col);
//		for(j = 0;j < 128;j ++)  //一行32字节
//			LDZ_WriteDAT(null[j + i*128 + id*256]);
//	}
//}


/**************************************************************************
* 函数名称： LDZ_Init
* 功能描述： LDZ初始化
**************************************************************************/
void LDZ_Init(void)
{
    LDZ_CS_H();
    LDZ_SCK_H();
    LDZ_SDA_H();
    
    LDZ_RE_H(); Ddl_Delay1ms(10);
    LDZ_RE_L(); Ddl_Delay1ms(10);
    LDZ_RE_H(); Ddl_Delay1ms(50);
}

void Ddl_Delay1ms(uint32_t ms)
{
	HAL_Delay(ms);
	
}

uint8_t Take_smallernumber(float num)
{
	int temp=num;
	float I=(num-temp)*10;
	return I;
}


// 动画帧数
#define NUM_FRAMES 30

// 定义一个全局变量用于控制动画是否继续播放
bool animationPlaying = true;

// 函数功能：实现从中间向两边显示的动画效果，并可控制播放速度
void LDZ_ShowPictureAnimation(u8 page_start, u8 page_end, u8 col_start, u8 col_end, const uint8_t *picture_data) {
    u8 frame = 0;
    while (frame < NUM_FRAMES && animationPlaying) {
        // 计算当前帧在页和列方向上从中间向两边扩展的范围
        u8 center_page = (page_start + page_end) / 2;
        u8 center_col = (col_start + col_end) / 2;
        u8 page_range = (page_end - page_start) * frame / (NUM_FRAMES - 1);
        u8 col_range = (col_end - col_start) * frame / (NUM_FRAMES - 1);

        for (u8 page = page_start; page <= page_end; page++) {
            LDZ_SetAddr(page, col_start);
            for (u8 col = col_start; col <= col_end; col++) {
                if ((page >= center_page - page_range / 2 && page <= center_page + page_range / 2) &&
                    (col >= center_col - col_range / 2 && col <= center_col + col_range / 2)) {
                    LDZ_WriteDAT(picture_data[(page - page_start) * (col_end - col_start + 1) + (col - col_start)]);
                } else {
                    LDZ_WriteDAT(0);
                }
            }
        }

        frame++;
        // 使用HAL库的延时函数
        HAL_Delay(30); // 100毫秒延迟
    }
}